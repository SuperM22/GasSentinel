## gasSentinel/main/Kconfig.projbuild
```kconfig
menu "Application Configuration"

	choice CONNECTION
		prompt "Wi-Fi availability"
		default WIFI
		help
			Select the AP availability.
		config WIFI
			bool "WI-FI ON"
			help
				The wi-fi is available.
		config NOWIFI
			bool "WI-FI OFF"
			help
				The wi-fi is NOT available.
	endchoice

	choice NEIGHBOUR_ALERT
		prompt "Receive near devices alert"
		default RECEIVE
		help
			Select if you want to receive alerts from nearby devices.
		config RECEIVE
			bool "ON"
			help
				Your device will be alerted when near devices senses gas.
		config NORECEIVE
			bool "OFF"
			help
				The device will NOT enter the alert state when other devices trigger.
	endchoice

	config WIFI_SSID
        string "WiFi SSID"
        default "myssid"
        help
            SSID (network name) for the app to connect to.

    config WIFI_PASSWORD
        string "WiFi Password"
        default "mypassword"
        help
            WiFi password (WPA or WPA2) for the app to use.

	config ADDRESS
		string "Device Address"
		default "ADDRESS"
		help
			Address to locate the gas leaks.

endmenu 
```
